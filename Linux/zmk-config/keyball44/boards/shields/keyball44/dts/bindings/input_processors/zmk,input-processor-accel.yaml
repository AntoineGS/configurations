## Linux/zmk-config/keyball44/boards/shields/keyball44/dts/bindings/input_processors/zmk,input-processor-accel.yaml
```yaml
# Copyright (c) 2024, The ZMK Contributors
# SPDX-License-Identifier: MIT

description: Input Processor for quadratic mouse acceleration

compatible: "zmk,input-processor-accel"

include: ip_common.yaml

properties:
  "#input-processor-cells":
    type: int
    required: true
    const: 0

  type:
    type: int
    required: true
    description: Input event type to process (e.g., INPUT_EV_REL for relative movement)

  codes:
    type: array
    required: true
    description: Input codes to apply acceleration to (e.g., INPUT_REL_X, INPUT_REL_Y)

  accel-divider:
    type: int
    default: 8
    description: |
      Acceleration divider for quadratic formula: x*x/divider+x
      Lower values = more acceleration. Original QMK default is 16, this uses 8 for more acceleration.
```

## Linux/zmk-config/keyball44/boards/shields/nice_view_no_wpm/Kconfig.shield
```kconfig
# Copyright (c) 2022 The ZMK Contributors
# SPDX-License-Identifier: MIT

config SHIELD_NICE_VIEW_NO_WPM
    def_bool $(shields_list_contains,nice_view_no_wpm)
```

## Linux/zmk-config/keyball44/config/west.yml
```yaml
manifest:
  remotes:
    - name: zmkfirmware
      url-base: https://github.com/zmkfirmware
    - name: antoinegs
      url-base: https://github.com/AntoineGS
    - name: gpeye
      url-base: https://github.com/GPeye
    - name: m165437
      url-base: https://github.com/M165437
  projects:
    - name: zmk
      remote: zmkfirmware
      revision: v0.3-branch
      import: app/west.yml
    - name: zmk-pmw3610-driver
      revision: main
      path: modules/drivers/zmk-pmw3610-driver
      remote: antoinegs
    - name: mario-peripheral-animation
      remote: gpeye
      revision: main
    - name: nice-view-gem
      remote: m165437
      revision: main
  self:
    path: config
```
